#include <Key.h>
#include <Keypad.h>
#include <MsTimer2.h>

#define Rows 4
#define Clos 4

//595 2控制行，595 1控制列
int latchPin1 = 5,latchPin2=2;
int clockPin1 = 6,clockPin2 = 3;
int dataPin1 = 7,dataPin2 = 4;

//keypad库所需的初始化
const char userKeyMap[Rows][Clos]={{'1','2','3','A'},{'4','5','6','B'},{'7','8','9','C'},{'*','0','#','D'}};
const byte pinR[Rows]={8,9,10,11};
const byte pinC[Clos]={12,13,14,15};
Keypad keypad = Keypad(makeKeymap(userKeyMap),pinR,pinC,Rows,Clos);

int showid,nowr = 1,nowc = 0;

//字符编码
int code[][8]=
{
 0x00,0x3e,0x41,0x41,0x41,0x3e,0x00,0x00, //0
 0x00,0x00,0x00,0x21,0x7f,0x01,0x00,0x00, //1
 0x00,0x27,0x45,0x45,0x45,0x39,0x00,0x00, //2
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 0x24,0x2f,0xf4,0x24,0x2f,0xf4,0x24,0x00  //#
 //
};

void setup() 
{
  pinMode(latchPin1, OUTPUT); pinMode(clockPin1, OUTPUT);  pinMode(dataPin1, OUTPUT);
  pinMode(latchPin2, OUTPUT); pinMode(clockPin2, OUTPUT);  pinMode(dataPin2, OUTPUT);//设置相应引脚
  MsTimer2::set(1,dosLed);      
  MsTimer2::start(); 
  for(int i=0;i<Rows;i++)
    pinMode(pinR[i],INPUT);
  for(int i=0;i<Clos;i++)
    pinMode(pinC[i],INPUT);  
}

void dosLed(){
  nowc ++;
  nowc %= 8;
  digitalWrite(latchPin1,LOW);
  digitalWrite(latchPin2,LOW);
  shiftOut(dataPin1, clockPin1, LSBFIRST, 0xff-(1<<nowc));        //输出列
  shiftOut(dataPin2, clockPin2, MSBFIRST, code[showid][nowc]);    //输出行
  digitalWrite(latchPin1,HIGH);
  digitalWrite(latchPin2,HIGH);
}
void loop() {
  // put your main code here, to run repeatedly:
  getid();         //从键盘获得的输入
}

void getid()       //转换
{
 char in=keypad.getKey(); 
 if(in)
 {
  if('0'<=in && in<='9')
  {
    showid=in-'0';
  }
  else if('A'<=in && in<'E')
  {
   showid=in-'A'+10;
  }
  else if(in=='*')
  {
   showid=14;
  }
  else if(in=='#')
  {
   showid=15;
  }
 }
}
